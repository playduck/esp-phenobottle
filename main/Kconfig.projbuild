## main/Kconfig.projbuild
```kconfig
menu "Phenobottle Configuration"
    config USERNAME
        string
        prompt "Username"
        default ""

    config PASSWORD
        string
        prompt "Password"
        default ""
endmenu
```
